## main/Kconfig.projbuild
```kconfig
menu "Rover Settings"


config APP_FRAME_SIZE
string "Frame size (QQVGA..UXGA)"
default "QVGA" # try QVGA/SVGA/XGA/UXGA depending on FPS needs


config APP_JPEG_QUALITY
int "JPEG quality (lower=better)"
range 5 63
default 12


config APP_DUAL_FB
bool "Use double frame buffers (faster MJPEG)"
default y


endmenu
```

## sdkconfig.defaults
```kconfig
# Wi‑Fi
CONFIG_ESP_WIFI_SSID="xfi01"
CONFIG_ESP_WIFI_PASSWORD="oneill2ls"
CONFIG_ESP_WIFI_AUTH_WPA2_PSK=y


# Enable PSRAM for ESP32‑S3 (required for streaming)
CONFIG_SPIRAM=y
CONFIG_SPIRAM_MODE_QUAD=y
CONFIG_SPIRAM_SPEED_80M=y
CONFIG_ESP32S3_DATA_CACHE_64KB=y
CONFIG_ESP32S3_INSTRUCTION_CACHE_64KB=y


# HTTP server
CONFIG_HTTPD_MAX_REQ_HDR_LEN=1024
CONFIG_HTTPD_MAX_URI_LEN=128


# Log level
CONFIG_LOG_DEFAULT_LEVEL_INFO=y
```
